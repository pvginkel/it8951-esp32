## Kconfig.projbuild
```kconfig
menu "IT8951 controller"

    config IT8951_SPI_HOST
        int "The SPI host the display is connected to"
        default 0

    config IT8951_SPI_BUS_SPEED_DIVIDER
        int "The SPI bus speed divider"
        default 7

    config IT8951_RESET_PIN
        int "Reset pin"
        default -1

    config IT8951_DISPLAY_READY_PIN
        int "Display ready"
        default -1

    config IT8951_CS_PIN
        int "CS pin"
        default -1

    config IT8951_MOSI_PIN
        int "MOSI pin"
        default -1

    config IT8951_MISO_PIN
        int "MISO pin"
        default -1

    config IT8951_SCLK_PIN
        int "SCLK pin"
        default -1
            
endmenu
```

## examples/gc16/sdkconfig.defaults
```kconfig
# Configure the SPI host to use for the controller.

CONFIG_IT8951_SPI_HOST=2
CONFIG_IT8951_SPI_BUS_SPEED_DIVIDER=7

# Set the pin numbers according to how the controller is connected to the device.

CONFIG_IT8951_RESET_PIN=9
CONFIG_IT8951_DISPLAY_READY_PIN=8
CONFIG_IT8951_CS_PIN=10
CONFIG_IT8951_MOSI_PIN=11
CONFIG_IT8951_MISO_PIN=13
CONFIG_IT8951_SCLK_PIN=12
```
